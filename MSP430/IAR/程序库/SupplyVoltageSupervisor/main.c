/*----------------------------------------------------------------
 * Copyright (C) 2011 江苏大学 电气学院416 刘中原
 * 版权所有。 
 * 
 * 文件名： main.c
 * 
 * 文件功能描述：   
 *          MSP430F16x系列单片机SVS(电源电压监控器)程序库演示
 *      说明：  
 *          该程序演示利用电源电压监控或是外部电压监控，电压过低时
 *          通过液晶给出提示。
 *
 * 创建标识：   刘中原20110827
 * 
 * 修改标识：   
 * 修改描述：   
**----------------------------------------------------------------*/

#include <msp430x16x.h>   //430寄存器头文件
#include <stdio.h>
#include "Lcd12864.h"
#include "SVS.h"

/****************************************************************************
* 名    称：ClkInit
* 功    能：时钟系统初始化  MCLK为8MHz，SMCLK为1MHz
* 入口参数：无
* 出口参数：无
****************************************************************************/
void ClkInit()
{
    char i;
    BCSCTL1 &= ~XT2OFF;             //打开XT2振荡器
    IFG1&=~OFIFG;                   //清除振荡错误标志
    while((IFG1&OFIFG)!=0)
    {
        for(i=0;i<0xff;i++);
        IFG1&=~OFIFG;               //清除振荡错误标志
    }
    BCSCTL2 |= SELM_2+SELS+DIVS_3;  //MCLK为8MHz，SMCLK为1MHz
}

/****************************************************************************
* 名    称：main主程序
* 功    能：设置串口，输出信息，从串口读计算机键盘输入数据，测试串口收发
* 入口参数：无
* 出口参数：无
* 说    明：复位测试时 每次电压调低再调正常 液晶显示的数据加1
            不复位时 每次调低 输出一个电压过低。
****************************************************************************/
void main()
{
    // Stop watchdog timer to prevent time out reset
    WDTCTL = WDTPW + WDTHOLD;
    ClkInit();
    LcdInit();
    
    /*//======== 电压过低时复位测试============
    __no_init char ff;      //复位不初始化

    SVSSetup(0x0A,1);       //检测电源电压 3.05v 低于3.05v时单片机复位
    ff++;                   //此变量 每次复位加1
    printf("%d",ff);        // 电压调低（<3.05v）再调高，显示变量将加1
    LPM0;
    */
    SVSSetup(0x0A,0);       //测电源电压 3.05v 低于3.05v时单片机 不复位
                            //0x0A 改为0x0f 则对P6.7电压监控 检测是否低于1.2v
    while(1)
    {
        if(SvsFlg()) 
            printf("电压过低");
        //SVSFG位必须 软件清零，如果电压没有回到3.05以上，
        //位的值立即被单片机置为1
        ClearSvs(1);        //清除标志 直到恢复正常电压
    }
}
