/*----------------------------------------------------------------
 * Copyright (C) 2011 江苏大学 电气学院416 刘中原
 * 版权所有。 
 * 
 * 文件名： main.c
 * 
 * 文件功能描述：   
 *          MSP430F16x,MSP430F14X外部AD操作函数(SPI接口)示例程序
 *      说明：  
 *          AD7708.c加入工程，包含AD7708.h即可使用，具体见本文件中
 *          的程序使用情况。
 *
 * 创建标识：   刘中原20110816
 * 
 * 修改标识：   
 * 修改描述：   
**----------------------------------------------------------------*/

#include "msp430x16x.h"     //430寄存器头文件
#include "AD7708.h"         //ad7708操作头文件

/****************************************************************************
* 名    称：ClkInit
* 功    能：时钟系统初始化  MCLK为8MHz，SMCLK为1MHz
* 入口参数：无
* 出口参数：无
****************************************************************************/
void ClkInit()
{
    char i;
    BCSCTL1 &= ~XT2OFF;             //打开XT2振荡器
    IFG1&=~OFIFG;                   //清除振荡错误标志
    while((IFG1&OFIFG)!=0)
    {
        for(i=0;i<0xff;i++);
        IFG1&=~OFIFG;               //清除振荡错误标志
    }
    BCSCTL2 |= SELM_2+SELS+DIVS_3;  //MCLK为8MHz，SMCLK为1MHz
}

/****************************************************************************
* 名    称：main主程序
* 功    能：测试AD7708操作函数
* 入口参数：无
* 出口参数：无
****************************************************************************/
long a;
void main()
{
    // Stop watchdog timer to prevent time out reset
    WDTCTL = WDTPW + WDTHOLD;
    ClkInit();
    AD7708Init(0);  //禁止斩波 1时启用斩波
    
    _EINT();        //开中断，程序需要用到SPI的中断；冲突，可以更改SPI函数
    
    while(1)                    //串口测试
    {
        AD7708Start(0);
        a = AD7708ReadResultData();         //读取AD采样后的结果
        //电压计算方法：a*1.024*2.5(参考电压)/65535
        a = AD7708ReadRegister(0);          //去状态值，此处函数不需要用
        
    }
}

