/*----------------------------------------------------------------
 * Copyright (C) 2011 江苏大学 电气学院416 刘中原
 * 版权所有。 
 * 
 * 文件名： main.c
 * 
 * 文件功能描述：   
 *          MSP430F16x,MSP430F14X系列单片机SPI函数库示例程序
 *      说明：  
 *          该程序示范SPI 通讯函数库内的各函数使用方法，该程序的演
 *          示需要修改spi.c里面 初始化函数，注释掉那句去掉注释，这
 *          样发送的数据就被自己接收到，完成测试。
 *          
 *          运行测试需进行单步调试，通过调试器观察读取的数据是否为
 *          发送出去的字符。
 *
 * 创建标识：   刘中原20110809
 * 
 * 修改标识：   
 * 修改描述：   
**----------------------------------------------------------------*/

#include "msp430x16x.h"   //430寄存器头文件
#include "Spi.h"         //串口通讯程序库头文件

char str[] = "UartWriteChar 函数工作正常!"; //ROM中一个字符串

/****************************************************************************
* 名    称：ClkInit
* 功    能：时钟系统初始化  MCLK为8MHz，SMCLK为1MHz
* 入口参数：无
* 出口参数：无
****************************************************************************/
void ClkInit()
{
    char i;
    BCSCTL1 &= ~XT2OFF;             //打开XT2振荡器
    IFG1&=~OFIFG;                   //清除振荡错误标志
    while((IFG1&OFIFG)!=0)
    {
        for(i=0;i<0xff;i++);
        IFG1&=~OFIFG;               //清除振荡错误标志
    }
    BCSCTL2 |= SELM_2+SELS+DIVS_3;  //MCLK为8MHz，SMCLK为1MHz
}

/****************************************************************************
* 名    称：main主程序
* 功    能：设置串口，输出信息，从串口读计算机键盘输入数据，测试串口收发
* 入口参数：无
* 出口参数：无
****************************************************************************/
void main()
{
    // Stop watchdog timer to prevent time out reset
    WDTCTL = WDTPW + WDTHOLD;
    
    ClkInit();
    // 主机模式，波特率25000,8位数据位，三线模式，时钟模式0（具体见spi.c）
    SpiMasterInit(25000,8,3,0);
    _EINT(); 
    
    
    while(1)                    //串口测试
    {
        SpiWriteData(0X20);     //只写入
        char a = SpiWriteData(0xff);    //只读取
    }
}

